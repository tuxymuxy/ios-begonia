## devices/begonia/configs/begonia_defconfig
```kconfig
# Begonia single-core bring-up: common kernel only, no phone or virtual drivers.
# This is a build profile, not a working device port.
#include defconfig
CONFIG_DEVICE="begonia"
CONFIG_FIRMWARE="none"
CONFIG_CPUS=1
# CONFIG_HAKIOS_ADRENO is not set
# CONFIG_HAKIOS_ADSP is not set
# CONFIG_HAKIOS_BATTERY is not set
# CONFIG_HAKIOS_BATTGUARD is not set
# CONFIG_HAKIOS_BT is not set
# CONFIG_HAKIOS_BUTTONS is not set
# CONFIG_HAKIOS_CAMERA is not set
# CONFIG_HAKIOS_CPUFREQ is not set
# CONFIG_HAKIOS_GOODIX is not set
# CONFIG_HAKIOS_HAPTIC is not set
# CONFIG_HAKIOS_MIC is not set
# CONFIG_HAKIOS_MODEM is not set
# CONFIG_HAKIOS_PMIC is not set
# CONFIG_HAKIOS_QMI is not set
# CONFIG_HAKIOS_SOCINFO is not set
# CONFIG_HAKIOS_SOUND is not set
# CONFIG_HAKIOS_SPEAKER is not set
# CONFIG_HAKIOS_THERMAL is not set
# CONFIG_HAKIOS_TORCH is not set
# CONFIG_HAKIOS_UFS is not set
# CONFIG_HAKIOS_VIRTIO_BLK is not set
# CONFIG_HAKIOS_VIRTIO_INPUT is not set
# CONFIG_HAKIOS_VIRTIO_NET is not set
# CONFIG_HAKIOS_VIRTIO_SOUND is not set
# CONFIG_HAKIOS_WIFI is not set
```
